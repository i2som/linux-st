// SPDX-License-Identifier: (GPL-2.0+ OR BSD-3-Clause)
/*
 * Copyright (C) i2SOM 2018 - All Rights Reserved
 * Author: Steve Chen <steve.chen@i2som.tech>.
 */

/dts-v1/;

#include "stm32mp157a-i2cmp15xbe-lcd070p1024c.dts"

&m_can2 {
	status = "okay";
};

&uart5 {
	status = "disabled";
};

